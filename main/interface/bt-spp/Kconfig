## main/interface/bt-spp/Kconfig
```kconfig
config AT_BASE_ON_BT_SPP
    bool "AT through Bluetooth SPP"

if AT_BASE_ON_BT_SPP
menu "AT Bluetooth SPP settings"

config AT_BT_SPP_DEVICE_NAME
    string "Bluetooth deivce name"
    default "ESP_AT_FOR_EV3"
    depends on AT_BASE_ON_BT_SPP
    
config AT_BT_SPP_SERVICE_NAME
    string "SPP service name"
    default "Serial Port"
    depends on AT_BASE_ON_BT_SPP

config AT_BT_SPP_PIN_CODE
    string "PIN code (4 to 16 numeric characters)"
    default "1234"
    depends on AT_BASE_ON_BT_SPP
endmenu
endif
```
